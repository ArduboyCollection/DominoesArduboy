const byte PROGMEM hourglass[] = {

  26, 32,

  0x00, 0x00, 0x00, 0x00, 0x00, 0x0F, 0xF9, 0x09, 0x49, 0x89, 0x49, 0x89, 0x49, 0x89, 0x49, 0x89, 0x49, 0x09, 0xF9, 0x0F, 0x00, 0x00, 0x00, 0x00, 0x00, 0x00,
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  0x00, 0x00, 0x00, 0x00, 0x00, 0x00, 0x01, 0x02, 0x05, 0x0E, 0x05, 0x00, 0x00, 0x00, 0x00, 0x00, 0x00, 0x00, 0x00, 0x00, 0x00, 0x00, 0x00, 0x00, 0x00, 0x00,

};


#define MESSAGE_BOX_DELAY_INIT      500
#define MESSAGE_BOX_DELAY           20
#define MESSAGE_BOX_DELAY_SHORT     5

#define MESSAGE_BOX_X     		      BONES_GRAVEYARD_X
#define MESSAGE_BOX_X_MAX  		      BONES_GRAVEYARD_X_MAX
#define MESSAGE_BOX_Y               BONES_GRAVEYARD_Y
#define MESSAGE_BOX_Y_MAX           BONES_GRAVEYARD_Y_MAX - 4
#define MESSAGE_BOX_Y_2_LINE        MESSAGE_BOX_Y + 11
#define MESSAGE_BOX_Y_3_LINE        MESSAGE_BOX_Y + 7


/* ----------------------------------------------------------------------------
    Render a message box with an animated hourglass.

    Render a message box with an animated hourglass when the computer is about
    to play a bone.  The animation can get quite annoying - especially when
    debugging so it can conditionally be suppressed by removing the definition
    ANIMATIONS.  The user can skip the animation by pressing the A or B button.
    Once the animation is complete, a confirmation of the bone being played 
    is shown.

*/
void drawMessageBox_WithHourglass(byte boneIdx) {

#ifdef ANIMATIONS
  int rotations = 2;
#endif

  arduboy.fillRect(BONES_GRAVEYARD_X, BONES_GRAVEYARD_Y, BONES_GRAVEYARD_X_MAX, BONES_GRAVEYARD_Y_MAX, BLACK);

#ifdef ANIMATIONS

  drawHorizontalDottedLine(MESSAGE_BOX_X, MESSAGE_BOX_X_MAX, MESSAGE_BOX_Y);
  drawHorizontalDottedLine(MESSAGE_BOX_X, MESSAGE_BOX_X_MAX, MESSAGE_BOX_Y_MAX);

  while (rotations > 0) {

    if ((arduboy.nextFrame())) {

      arduboy.fillRect(MESSAGE_BOX_X, MESSAGE_BOX_Y + 1, BONES_GRAVEYARD_X_MAX, MESSAGE_BOX_Y_MAX - 2, BLACK);
      sprites.drawSelfMasked(MESSAGE_BOX_X + 23, MESSAGE_BOX_Y + 10, hourglass, frame);

      if (arduboy.everyXFrames(3)) frame++;

      if (frame > 11 || (rotations == 1 && frame == 9)) {

        rotations--;
        frame = 0;

      }

      arduboy.display();

    }

    if (arduboy.pressed(A_BUTTON) || arduboy.pressed(B_BUTTON)) {
      break;
    }

  }

#endif

  frame = 0;

  arduboy.fillRect(MESSAGE_BOX_X, MESSAGE_BOX_Y + 1, MESSAGE_BOX_X_MAX, MESSAGE_BOX_Y_MAX - 2, BLACK);
  arduboy.setCursor(MESSAGE_BOX_X + 2, MESSAGE_BOX_Y_2_LINE);
  arduboy.print("I will playthe    bone");
  arduboy.drawPixel(126, 29, WHITE);
  drawBone_Rotated(bones_ref[boneIdx], MESSAGE_BOX_X + 23, 22, false);

  arduboy.display();
  DelayOrButtonPress(MESSAGE_BOX_DELAY);

}


/* ----------------------------------------------------------------------------
 *  Render a simple message.
 */
void drawMessageBox(String message, byte lines, bool waitForButtonPress) {

  drawMessageBox(message, lines, waitForButtonPress, NOTHING);

}

void drawMessageBox(String message, byte lines, bool waitForButtonPress, byte renderScore) {

  arduboy.delayShort(MESSAGE_BOX_DELAY_INIT);

  arduboy.fillRect(BONES_GRAVEYARD_X, BONES_GRAVEYARD_Y, BONES_GRAVEYARD_X_MAX, BONES_GRAVEYARD_Y_MAX, BLACK);
  drawHorizontalDottedLine(MESSAGE_BOX_X, MESSAGE_BOX_X_MAX, MESSAGE_BOX_Y);
  drawHorizontalDottedLine(MESSAGE_BOX_X, MESSAGE_BOX_X_MAX, MESSAGE_BOX_Y_MAX);
  arduboy.setCursor(MESSAGE_BOX_X + 2, (lines == 2 ? MESSAGE_BOX_Y_2_LINE : MESSAGE_BOX_Y_3_LINE));
  arduboy.print(message);

  arduboy.display();


  // Should a players score be updated?

  if (renderScore != NOTHING) {
    renderPlayersScore(renderScore, NOTHING);
  }


  // Should the message box be dismissed after a delay or wait until a button is pressed?

  if (waitForButtonPress) {

    WaitForButtonPress();

  }
  else {

    DelayOrButtonPress((renderScore == NOTHING ? MESSAGE_BOX_DELAY : MESSAGE_BOX_DELAY_SHORT));

  }

}

/* ----------------------------------------------------------------------------
 *  Render an exit message box.
 */
boolean exitGame() {

  arduboy.fillRect(BONES_GRAVEYARD_X, BONES_GRAVEYARD_Y, BONES_GRAVEYARD_X_MAX, BONES_GRAVEYARD_Y_MAX, BLACK);
  drawHorizontalDottedLine(MESSAGE_BOX_X, MESSAGE_BOX_X_MAX, MESSAGE_BOX_Y);
  drawHorizontalDottedLine(MESSAGE_BOX_X, MESSAGE_BOX_X_MAX, MESSAGE_BOX_Y_MAX);
  arduboy.setCursor(MESSAGE_BOX_X + 2, MESSAGE_BOX_Y_3_LINE);
  arduboy.print("Leave game and return?");

  arduboy.display();
  arduboy.delayShort(500);
    
  arduboy.setCursor(MESSAGE_BOX_X + 2, MESSAGE_BOX_Y_3_LINE + 28);
  arduboy.print("Confirm");

  arduboy.fillCircle(115, 38, 5, WHITE);
  
  arduboy.setCursor(110 + 3, 35);
  arduboy.setTextColor(BLACK);
  arduboy.setTextBackground(WHITE);
  arduboy.print("B");

  arduboy.setTextColor(WHITE);
  arduboy.setTextBackground(BLACK);
  arduboy.display();

  return (WaitForButtonPress() == B_BUTTON ? true : false);

}
